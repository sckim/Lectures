library ieee;
use ieee.std_logic_1164.all;
use ieee.numeric_std.all;

ENTITY UART IS
PORT( CLOCK_50: IN STD_LOGIC;
		-- generate input data
		SW: IN STD_LOGIC_VECTOR(9 downto 0);
		KEY: IN STD_LOGIC_VECTOR(3 downto 0);
		-- output display
		LEDR: OUT STD_LOGIC_VECTOR(9 downto 0);
		-- input display
		LEDG: OUT STD_LOGIC_VECTOR(7 downto 0);
		
		UART_TXD: OUT STD_LOGIC;
		UART_RXD: IN STD_LOGIC
);

END UART;

ARCHITECTURE MAIN OF UART IS
SIGNAL TX_DATA: STD_LOGIC_VECTOR(7 DOWNTO 0);
SIGNAL TX_START: STD_LOGIC:='0';
SIGNAL TX_BUSY: STD_LOGIC;
SIGNAL RX_DATA: STD_LOGIC_VECTOR(7 DOWNTO 0);
SIGNAL RX_BUSY: STD_LOGIC;

------------
COMPONENT TX
PORT( CLK: IN STD_LOGIC;
		START: IN STD_LOGIC;
		BUSY: OUT STD_LOGIC;
		DATA: IN STD_LOGIC_VECTOR(7 downto 0);
		TX_LINE: OUT STD_LOGIC		
);
END COMPONENT TX;

------------
COMPONENT RX
PORT( CLK: IN STD_LOGIC;
	RX_LINE: IN STD_LOGIC;
	DATA: OUT STD_LOGIC_VECTOR(7 downto 0);
	BUSY: OUT STD_LOGIC
);
END COMPONENT RX;


BEGIN
C1: TX PORT MAP( CLOCK_50, TX_START, TX_BUSY, TX_DATA, UART_TXD);
C2: RX PORT MAP( CLOCK_50, UART_RXD, RX_DATA, RX_BUSY);

-- receive rx data
PROCESS(RX_BUSY)
BEGIN
IF(falling_edge(RX_BUSY)) THEN
LEDR(7 DOWNTO 0) <= RX_DATA;
END IF;
END PROCESS;

-- send tx data
PROCESS(CLOCK_50)
BEGIN
IF(rising_edge(CLOCK_50)) THEN
	IF(KEY(0)='0' AND TX_BUSY='0') THEN
		TX_DATA <= SW(7 DOWNTO 0);
		TX_START <= '1';
		LEDG <= TX_DATA;
	ELSE
		TX_START <= '0';
	END IF;
END IF;
END PROCESS;

END MAIN;